## Kconfig
```kconfig
menu "NET Logging"

	config NETLOGGING_USE_RINGBUFFER
		bool "Use xRingBuffer as IPC"
		default n
		help
			Use xRingBuffer as IPC instead of xMessageBuffer.
			Both xMessageBuffer and xRingBuffer are interprocess communication (IPC) components provided by ESP-IDF.
			Several drivers provided by ESP-IDF already use xRingBuffer.
			This project uses xMessageBuffer by default.
			If you use this project at the same time as a driver that uses xRingBuffer, using xRingBuffer may save some memory.
			Memory usage status can be checked with idf.py size-components.

	config NETLOGGING_MESSAGE_MAX_LENGTH
		int "Max message length"
		default 256
		help
			Set the maximum message length.
			Note: This is the maximum length of a single log message.
			Make sure to set this value according to your needs.
			For example, if you expect to log large messages, you may want to increase this value.
			Conversely, if you are concerned about memory usage, you may want to decrease this value.

	config NETLOGGING_BUFFER_SIZE
		int "Buffer size"
		default 1024
		help
			Set the buffer size for logging.
			Note: This is the size of the buffer used for logging messages.
			Make sure to set this value according to your needs.
			For example, if you expect to log large messages, you may want to increase this value.
			Conversely, if you are concerned about memory usage, you may want to decrease this value.

	config NETLOGGING_CUSTOM_SSE_ASSETS
		bool "Use a custom index.html asset for the built-in HTTP SSE Loggging Server"
		default n
		help
			Enable this to provide a customized version of index.html to be included in the built-in HTTP SSE Loggging Server.
			The file must be provided by your project. See examples/sse_server for how to do it.

endmenu
```

## examples/basic/main/Kconfig.projbuild
```kconfig
menu "Example Project Config"

    config EXAMPLE_USE_NETLOGGING
        bool "Enable net-logging component"
        default y
        help
            Enable the core net-logging component

    if EXAMPLE_USE_NETLOGGING

        config EXAMPLE_USE_NETLOGGING_SSE_SERVER
            bool "Use HTTP SSE Logging Server"
            default y
            help
                Use HTTP SSE Logging Server.

        if EXAMPLE_USE_NETLOGGING_SSE_SERVER

            config EXAMPLE_NETLOGGING_SSE_LISTEN_PORT
                int "[SSE] Port to bind the SSE server on"
                default 8080
                help
                    Port to bind the HTTP SSE logging server on

        endif # EXAMPLE_USE_NETLOGGING_SSE_SERVER

        config EXAMPLE_USE_NETLOGGING_MULTICAST
            bool "Use IP Multicast to send logs"
            default y
            help
                Use IP Multicast to send logs.

        if EXAMPLE_USE_NETLOGGING_MULTICAST

            config EXAMPLE_NETLOGGING_MULTICAST_IP
                string "[Multicast] IP address/group to send log output"
                default "239.2.1.2"
                help
                    Multicast IP address/group to send log output

            config EXAMPLE_NETLOGGING_MULTICAST_PORT
                int "[Multicast] Port to send log output"
                default 2054
                help
                    Multicast Port to send log output

        endif # EXAMPLE_USE_NETLOGGING_MULTICAST

        config EXAMPLE_USE_NETLOGGING_UDP
            bool "Use UDP Client to send logs"
            default y
            help
                Use UDP Client to send logs.

        if EXAMPLE_USE_NETLOGGING_UDP

            config EXAMPLE_NETLOGGING_UDP_IP
                string "[UDP] IP address to send log output"
                default "255.255.255.255"
                help
                    IP address to send log output to

            config EXAMPLE_NETLOGGING_UDP_PORT
                int "[UDP] Port to send log output"
                default 6789
                help
                    Port to send log output to

        endif # EXAMPLE_USE_NETLOGGING_UDP

        config EXAMPLE_USE_NETLOGGING_TCP
            bool "Use TCP Client to send logs"
            default y
            help
                Use TCP Client to send logs.

        if EXAMPLE_USE_NETLOGGING_TCP

            config EXAMPLE_NETLOGGING_TCP_IP
                string "[TCP] IP address to send log output"
                default "192.168.10.46"
                help
                    IP address to send log output to

            config EXAMPLE_NETLOGGING_TCP_PORT
                int "[TCP] Port to send log output"
                default 8080
                help
                    Port to send log output to

        endif # EXAMPLE_USE_NETLOGGING_TCP


        config EXAMPLE_USE_NETLOGGING_HTTP_CLIENT
            bool "Use HTTP Client to send logs"
            default y
            help
                Use HTTP Client to send logs to an external HTTP server.

        if EXAMPLE_USE_NETLOGGING_HTTP_CLIENT

            config EXAMPLE_NETLOGGING_HTTP_CLIENT_CONNECT_URL
                string "[HTTP] URL of the http server to connect to"
                default "http://myhttpserver.local:8000"
                help
                    URL of the http server to connect to.

        endif # EXAMPLE_USE_NETLOGGING_HTTP_CLIENT

        config EXAMPLE_NETLOGGING_WRITE_TO_STDOUT
            bool "Enable Write Logging to stdout (UART)"
            default y
            help
                Enable Write Logging to stdout (UART) in addition to any network options.

    endif # EXAMPLE_USE_NETLOGGING






endmenu
```

## examples/mqtt_pub/Kconfig.projbuild
```kconfig
menu "Example Project Config"

    config EXAMPLE_USE_NETLOGGING
        bool "Enable net-logging component"
        depends on ENABLE_UDP_LOG
        default y
        help
            Enable the core net-logging component

    if EXAMPLE_USE_NETLOGGING

        config ENABLE_USE_NETLOGGING_MQTT_PUB
            bool "Use MQTT Logging"
            default n
            help
                Use MQTT Logging.

        if ENABLE_USE_NETLOGGING_MQTT_PUB

        config EXAMPLE_NETLOGGING_MQTT_PUB_SERVER_URL
            depends on ENABLE_MQTT_LOG
            string "URL of the mqtt server to connect to"
            default "mqtt://broker.emqx.io:1883"
            help
                URL of the mqtt server to connect to

        config EXAMPLE_NETLOGGING_MQTT_PUB_TOPIC
            depends on ENABLE_MQTT_LOG
            string "Publish Topic"
            default "/esp32/logging"
            help
                Topic of publish

        endif # ENABLE_USE_NETLOGGING_MQTT_PUB

        config EXAMPLE_NETLOGGING_WRITE_TO_STDOUT
            bool "Enable Write Logging to stdout (UART)"
            default y
            help
                Enable Write Logging to stdout (UART) in addition to any network options.

    endif # EXAMPLE_USE_NETLOGGING

endmenu
```

## examples/sse_server/main/Kconfig.projbuild
```kconfig
menu "Example Project Config"

    config EXAMPLE_USE_NETLOGGING
        bool "Enable net-logging component"
        default y
        help
            Enable the core net-logging component

    if EXAMPLE_USE_NETLOGGING
        config EXAMPLE_USE_NETLOGGING_SSE_SERVER
            bool "Use HTTP SSE Logging Server"
            default y
            help
                Use HTTP SSE Logging Server.

        if EXAMPLE_USE_NETLOGGING_SSE_SERVER
            config EXAMPLE_NETLOGGING_SSE_LISTEN_PORT
                int "Port to bind the SSE server on"
                default 8080
                help
                    Port to bind the HTTP SSE logging server on

        endif # EXAMPLE_USE_NETLOGGING_SSE_SERVER

        config EXAMPLE_NETLOGGING_WRITE_TO_STDOUT
            bool "Enable Write Logging to stdout (UART)"
            default y
            help
                Enable Write Logging to stdout (UART) in addition to any network options.

    endif # EXAMPLE_USE_NETLOGGING

endmenu
```
